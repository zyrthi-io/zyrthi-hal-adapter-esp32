## Kconfig
```kconfig
menu "ZYRTHI HAL Adapter ESP32"

    config ZYRTHI_UART_DEFAULT_TX
        int "Default UART TX Pin"
        default 1
        help
            Default TX pin for UART0 (used by uart_default()).

    config ZYRTHI_UART_DEFAULT_RX
        int "Default UART RX Pin"
        default 3
        help
            Default RX pin for UART0 (used by uart_default()).

    config ZYRTHI_UART_DEFAULT_BAUD
        int "Default UART Baud Rate"
        default 115200
        help
            Default baud rate for UART0.

    config ZYRTHI_I2C_DEFAULT_SDA
        int "Default I2C SDA Pin"
        default 21
        help
            Default SDA pin for I2C0 (used by i2c_default()).

    config ZYRTHI_I2C_DEFAULT_SCL
        int "Default I2C SCL Pin"
        default 22
        help
            Default SCL pin for I2C0 (used by i2c_default()).

    config ZYRTHI_I2C_DEFAULT_CLOCK
        int "Default I2C Clock (Hz)"
        default 100000
        help
            Default I2C bus clock frequency in Hz.

    config ZYRTHI_PWM_DEFAULT_FREQ
        int "Default PWM Frequency (Hz)"
        default 5000
        help
            Default PWM frequency in Hz.

endmenu
```

## test/button_led/sdkconfig.defaults
```kconfig
# ESP32-S3
CONFIG_IDF_TARGET="esp32s3"

# 启用 PSRAM (R8 = 8MB)
CONFIG_ESP32S3_SPIRAM_SUPPORT=y
CONFIG_SPIRAM_MODE_OCT=y
CONFIG_SPIRAM_SPEED_80M=y

# 日志
CONFIG_LOG_DEFAULT_LEVEL_INFO=y

# 禁用看门狗
CONFIG_ESP_TASK_WDT_INIT=n
```

## test/hal_test/sdkconfig.defaults
```kconfig
# 目标芯片（运行时通过 idf.py set-target 设置）
# CONFIG_IDF_TARGET_ESP32=y

# 日志级别
CONFIG_LOG_DEFAULT_LEVEL_INFO=y
CONFIG_LOG_MAXIMUM_LEVEL_DEBUG=y

# FreeRTOS
CONFIG_FREERTOS_HZ=1000

# 禁用看门狗（调试用）
CONFIG_ESP_TASK_WDT_INIT=n
CONFIG_ESP_INT_WDT=n

# ADC 校准
CONFIG_ADC_CALI_SCHEME_CURVE_FITTING_SUPPORTED=y
CONFIG_ADC_CALI_SCHEME_LINE_FITTING_SUPPORTED=y
```
